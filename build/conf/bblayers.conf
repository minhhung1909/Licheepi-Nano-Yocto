## build/conf/bblayers.conf
```bitbake
# POKY_BBLAYERS_CONF_VERSION is increased each time build/conf/bblayers.conf
# changes incompatibly
POKY_BBLAYERS_CONF_VERSION = "2"

BBPATH = "${TOPDIR}"
BBFILES ?= ""

BBLAYERS ?= " \
  /home/shelbuntu/FTEL/embedded-linux/yocto/poky/meta \
  /home/shelbuntu/FTEL/embedded-linux/yocto/poky/meta-poky \
  /home/shelbuntu/FTEL/embedded-linux/yocto/poky/meta-yocto-bsp \
  /home/shelbuntu/FTEL/embedded-linux/yocto/poky/meta-openembedded/meta-oe \
  /home/shelbuntu/FTEL/embedded-linux/yocto/poky/meta-openembedded/meta-networking \
  /home/shelbuntu/FTEL/embedded-linux/yocto/poky/meta-openembedded/meta-python \
  /home/shelbuntu/FTEL/embedded-linux/yocto/poky/meta-licheepinano \
  /home/shelbuntu/FTEL/embedded-linux/yocto/meta-custom \
  "
```
